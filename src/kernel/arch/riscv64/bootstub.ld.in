/*
 * SPDX-FileCopyrightText: ukoOS Contributors
 *
 * SPDX-License-Identifier: GPL-3.0-or-later
 */

ENTRY(_start)
OUTPUT_FORMAT(elf64-littleriscv)

SECTIONS
{
	. = @BOOTSTUB_STARTADDR@;

	/**
	 * We mix up all the sections of the bootstub, since it won't run with
	 * page-level protection anyways.
	 */
	.bootstub :
	{
		_bootstub_start_phys = .;
		*(.text)
		*(.rodata)
		*(.data)
		*(.bss)
		. = ALIGN(0x1000);
		_bootstub_end_phys = .;
		ASSERT(
			_bootstub_end_phys == _bootstub_start_phys + 4096,
			".bootstub page was too large; fix it or change generate_bootstub.py"
		);
	}

	/**
	 * This gets set after the .bootstub page, since we never return back
	 * to it or use it in any way.
	 */
	_kernel_start_phys = .;

	/**
	 * The kernel's string and symbol table sections get appended.
	 */
	.kernel_tables ALIGN(0x1000) :
	{
		PROVIDE(__start_kernel_tables = .);
		*(.kernel_tables)
	}

	/**
	 * The kernel gets appended as a blob.
	 */
	.kernel ALIGN(0x1000) :
	{
		PROVIDE(__start_kernel = .);
		*(.kernel)
	}
	.kernel_bss :
	{
		*(.kernel_bss)
	}

	/**
	 * The initial heap segment and boothart stack.
	 */
	.initial_heap_segment ALIGN(0x1000) :
	{
		PROVIDE(__start_initial_heap_segment = .);
		. += 0x400000;
	}
	.boothart_stack ALIGN(0x1000) :
	{
		PROVIDE(__start_boothart_stack = .);
		. += 0x200000;
	}

	/**
	 * The page tables get appended as well.
	 */
	.pgtbls ALIGN(0x1000) :
	{
		*(.pgtbls)
	}

	_kernel_end_phys = .;

	INCLUDE "src/kernel/arch/riscv64/bootstub_generated.ld"
}
